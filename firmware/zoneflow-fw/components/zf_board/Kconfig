## firmware/zoneflow-fw/components/zf_board/Kconfig
```kconfig
menu "ZoneFlow board"

    choice ZF_BOARD
        prompt "Board"
        default ZF_BOARD_REV_A
        help
            Board definition header used for pins and board constants. The
            pins come from hardware/pinmap.yaml (generated at build time).

        config ZF_BOARD_REV_A
            bool "ZoneFlow rev A"
    endchoice

    config ZF_OE_TOGGLE_PERIOD_MS
        int "Keep-alive period (ms)"
        range 1 20
        default 5
        help
            Period of the keep-alive timer interrupt (GPTimer, IRAM-safe):
            one edge per period while outputs are wanted. Rev A needs an
            edge at least every 20 ms (hardware design 19.4); 5 ms is the
            agreed design point and the self-test timing is resolved to it.

    config ZF_OE_HEARTBEAT_TIMEOUT_MS
        int "Control-loop heartbeat timeout (ms)"
        range 100 5000
        default 500
        help
            The keep-alive interrupt stops the edges when the control loop
            has not run for this long, counted in keep-alive periods. A flash
            erase stalls the control loop; the keep-alive survives stalls
            shorter than this. Hardware design 19.4: do not lower it.

    config ZF_CONTROL_PERIOD_MS
        int "Control loop period (ms)"
        range 10 100
        default 50

endmenu
```
